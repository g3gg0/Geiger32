
#include <Wire.h>

#define ENABLE_GxEPD2_GFX 0
#define MIN(a,b) ((a)<=(b)?(a):(b))

#include <GxEPD2_BW.h>
#include <GxEPD2_3C.h>
#include <GxEPD2_7C.h>
#include <Fonts/FreeMonoBold9pt7b.h>
#include <U8g2_for_Adafruit_GFX.h>

// select the display class and display driver class in the following file (new style):
#include "GxEPD2_display_selection_new_style.h"

U8G2_FOR_ADAFRUIT_GFX u8g2Fonts;

const char epd_logo_string[] = "Geiger v3.1";
const char epd_logo_copyright[] = "\xA9 g3gg0.de";
#define geiger_width 128
#define geiger_height 140


uint64_t epd_lasttime = 0;
extern uint32_t det_counts_last;


/* https://www.flaticon.com/free-icon/geiger-counter_3325167 */

static unsigned char geiger_bw[] = {
   0x00, 0x00, 0x00, 0x00, 0x00, 0x00, 0x00, 0x00, 0x00, 0x00, 0x00, 0x00,
   0x00, 0x00, 0x00, 0x00, 0x00, 0x00, 0x00, 0x00, 0x00, 0x00, 0x00, 0x00,
   0x00, 0x00, 0x00, 0x00, 0x00, 0x00, 0x00, 0x00, 0x00, 0x00, 0x00, 0x00,
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   0xba, 0xdd, 0xfa, 0xff, 0xdf, 0xea, 0x06, 0x00 };

static unsigned char geiger_rw[] = {
   0x00, 0x00, 0x00, 0x00, 0x00, 0xa8, 0xad, 0xad, 0xad, 0xad, 0xad, 0xad,
   0xad, 0x15, 0x00, 0x00, 0x00, 0x00, 0x00, 0x00, 0x00, 0x6a, 0xb5, 0x6a,
   0xb5, 0x6a, 0xb5, 0x6a, 0xb5, 0xf6, 0x00, 0x00, 0x00, 0x00, 0x00, 0x00,
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   0x00, 0x00, 0x00, 0x00, 0x00, 0x00, 0x00, 0x00 };


void epd_show_logo()
{
    u8g2Fonts.setFontMode(1);                        // use u8g2 transparent mode (this is default)
    u8g2Fonts.setFontDirection(0);                   // left to right (this is default)
    u8g2Fonts.setForegroundColor(GxEPD_BLACK);                // apply Adafruit GFX color
    u8g2Fonts.setBackgroundColor(GxEPD_WHITE);                // apply Adafruit GFX color
    u8g2Fonts.setFont(u8g2_font_helvR14_tf);         // select u8g2 font from here: https://github.com/olikraus/u8g2/wiki/fntlistall
    int16_t tw = u8g2Fonts.getUTF8Width(epd_logo_string); // text box width
    int16_t ta = u8g2Fonts.getFontAscent();          // positive
    int16_t td = u8g2Fonts.getFontDescent();         // negative; in mathematicians view
    int16_t th = ta - td;                            // text box height

    uint16_t x = (display.width() - tw) / 2;
    uint16_t y = 20;

    display.firstPage();

    display.fillScreen(GxEPD_WHITE);
    display.drawXBitmap(0, y, geiger_bw, geiger_width, geiger_height, GxEPD_BLACK);
    display.drawXBitmap(0, y, geiger_rw, geiger_width, geiger_height, GxEPD_RED);

    y += geiger_height + 20;
    u8g2Fonts.setCursor(x, y);
    u8g2Fonts.setForegroundColor(GxEPD_BLACK);
    u8g2Fonts.print(epd_logo_string);

    y += th - 5;
    u8g2Fonts.setForegroundColor(GxEPD_RED);
    u8g2Fonts.setFont(u8g2_font_helvR08_tf);
    tw = u8g2Fonts.getUTF8Width(epd_logo_copyright); // text box width
    u8g2Fonts.setCursor((display.width() - tw) / 2, y);
    u8g2Fonts.print(epd_logo_copyright);
    display.displayWindow(0, 0, display.width(), display.height());
    
    //display.nextPage();
}

#define HISTORY_VALUES 100
void epd_update(uint32_t *values, uint32_t pos)
{
    char rad[32];
    //u8g2Fonts.setFontMode(1);
    //u8g2Fonts.setFontDirection(0);
    u8g2Fonts.setForegroundColor(GxEPD_BLACK);
    //u8g2Fonts.setBackgroundColor(GxEPD_WHITE);
    u8g2Fonts.setFont(u8g2_font_helvR14_tf);
    int16_t ta = u8g2Fonts.getFontAscent();          // positive
    int16_t td = u8g2Fonts.getFontDescent();         // negative; in mathematicians view
    int16_t th = ta - td;                            // text box height

    uint16_t window_x = 0;
    uint16_t window_y = geiger_height + 70;
    uint16_t window_width = display.width() - window_x;
    uint16_t window_height = display.height() - window_y;

    u8g2Fonts.setCursor(window_x, window_y);

    //display.setPartialWindow(window_x, window_y, window_width, window_height);
    display.fillRect(window_x, window_y, window_width, window_height, GxEPD_WHITE);
    display.setCursor(window_x, window_y+th);
    sprintf(rad, "%2.3f µS/h", values[(pos + HISTORY_VALUES - 1) % HISTORY_VALUES] * 0.006315f);
    int16_t tw = u8g2Fonts.getUTF8Width(rad);
    u8g2Fonts.setCursor((display.width() - tw) / 2, window_y+th);
    u8g2Fonts.print(rad);

    uint32_t plot_height = 40;
    uint32_t plot_x = 10;
    uint32_t plot_y = window_y + 35 + plot_height; /* baseline! */
    uint32_t plot_width = display.width() - plot_x;

    display.drawLine(plot_x - 1, plot_y - plot_height, plot_x - 1, plot_y + 4, GxEPD_RED);
    display.drawLine(plot_x - 4, plot_y + 1, plot_x + plot_width + 4, plot_y + 1, GxEPD_RED);

    uint32_t max_cpm = 100;

    if(pos < HISTORY_VALUES)
    {
        for(uint32_t entry = 0; entry < MIN(pos, plot_width); entry++)
        {
            uint32_t y = values[entry % HISTORY_VALUES] * plot_height / max_cpm;
            uint16_t color = GxEPD_BLACK;

            if(y > plot_height)
            {
                y = plot_height;
                color = GxEPD_RED;
            }

            display.drawLine(plot_x + entry, plot_y - y, plot_x + entry, plot_y, color);
        }
    }
    else
    {
        for(uint32_t entry = 0; entry < MIN(HISTORY_VALUES, plot_width); entry++)
        {
            uint32_t y = values[(pos + 1 + entry) % HISTORY_VALUES] * plot_height / max_cpm;
            uint16_t color = GxEPD_BLACK;

            if(y > plot_height)
            {
                y = plot_height;
                color = GxEPD_RED;
            }

            display.drawLine(plot_x + entry, plot_y - y, plot_x + entry, plot_y, color);
        }
    }
    
    display.displayWindow(window_x, window_y, window_width, window_height);
}


void epd_loop_task(void * parameter)
{
    uint32_t last_values_pos = 0;
    uint32_t last_values[HISTORY_VALUES];

    memset(last_values, 0x00, sizeof(last_values));
    epd_show_logo();

    while(1)
    {
        uint64_t now = millis();

        if(now - epd_lasttime > 60000)
        {
            epd_lasttime = now;
            Serial.printf("[EPD] udpate\n");

            last_values[last_values_pos++ % HISTORY_VALUES] = det_counts_last;
            epd_update(last_values, last_values_pos);
        }

        vTaskDelay(1000 / portTICK_PERIOD_MS);
    }
}

void epd_setup()
{
    pinMode(EPD_BUSY, INPUT);
    pinMode(EPD_RST, OUTPUT);
    pinMode(EPD_DC, OUTPUT);
    pinMode(EPD_CS, OUTPUT);

    digitalWrite(EPD_CS, HIGH);

    SPI.begin(EPD_SCLK, 13, EPD_MOSI, 15);

    display.init();
    u8g2Fonts.begin(display);

    xTaskCreate(
        epd_loop_task,    // Function that should be called
        "EPD task",   // Name of the task (for debugging)
        6000,            // Stack size (bytes)
        NULL,            // Parameter to pass
        1,               // Task priority
        NULL             // Task handle
    );
}
